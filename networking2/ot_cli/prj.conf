## prj.conf
```kconfig
#
# Copyright (c) 2024 Koen Vervloesem
#
# SPDX-License-Identifier: Apache-2.0
#

# Enable networking and OpenThread
CONFIG_NETWORKING=y
CONFIG_NET_IPV6_NBR_CACHE=n
CONFIG_NET_IPV6_MLD=n
CONFIG_NET_L2_OPENTHREAD=y
CONFIG_OPENTHREAD_THREAD_VERSION_1_3=y
CONFIG_OPENTHREAD_SLAAC=y
CONFIG_OPENTHREAD_PING_SENDER=y
CONFIG_OPENTHREAD_DNS_CLIENT=y
CONFIG_OPENTHREAD_MLR=y

# Kernel options
CONFIG_MAIN_STACK_SIZE=2560

# Enable logging
CONFIG_LOG=y
CONFIG_NET_LOG=y

# Enable Network and OpenThread shell commands over USB
CONFIG_SHELL=y
CONFIG_NET_SHELL=y
CONFIG_OPENTHREAD_SHELL=y
CONFIG_USB_DEVICE_INITIALIZE_AT_BOOT=y
```

## overlay-mtd.conf
```kconfig
CONFIG_OPENTHREAD_MTD=y
```

## overlay-sed.conf
```kconfig
CONFIG_OPENTHREAD_MTD=y
CONFIG_OPENTHREAD_MTD_SED=y
CONFIG_OPENTHREAD_POLL_PERIOD=1000
```

## boards/nrf52840dongle_nrf52840.conf
```kconfig
#
# Copyright (c) 2023 Nordic Semiconductor
#
# SPDX-License-Identifier: LicenseRef-Nordic-5-Clause
#

CONFIG_SHELL_BACKEND_SERIAL_INIT_PRIORITY=51

CONFIG_USB_CDC_ACM_LOG_LEVEL_OFF=y

CONFIG_USB_DEVICE_MANUFACTURER="Nordic Semiconductor ASA"
CONFIG_USB_DEVICE_PRODUCT="OpenThread CLI"
CONFIG_USB_DEVICE_VID=0x1915
CONFIG_USB_DEVICE_PID=0x0000
```

## src/main.c
```c
/*
 * Copyright (c) 2024 Koen Vervloesem
 *
 * SPDX-License-Identifier: Apache-2.0
 */

#include <zephyr/logging/log.h>

LOG_MODULE_REGISTER(ot_cli, LOG_LEVEL_DBG);

int main(void) {
  LOG_INF("Starting application...");
  return 0;
}
```
