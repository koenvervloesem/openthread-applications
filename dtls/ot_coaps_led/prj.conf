## CMakeLists.txt
```
# SPDX-License-Identifier: Apache-2.0

cmake_minimum_required(VERSION 3.20.0)

find_package(Zephyr REQUIRED HINTS $ENV{ZEPHYR_BASE})
project(ot_coaps_led)

target_sources(app PRIVATE src/main.c)
```

## prj.conf
```kconfig
#
# Copyright (c) 2024 Koen Vervloesem
#
# SPDX-License-Identifier: Apache-2.0
#

# Enable networking and OpenThread
CONFIG_NETWORKING=y
CONFIG_NET_IPV6_NBR_CACHE=n
CONFIG_NET_IPV6_MLD=n
CONFIG_NET_L2_OPENTHREAD=y
CONFIG_OPENTHREAD_THREAD_VERSION_1_3=y
CONFIG_OPENTHREAD_SLAAC=y
CONFIG_OPENTHREAD_PING_SENDER=y
CONFIG_OPENTHREAD_COAP=y

# Enable CoAPS with PSK
CONFIG_OPENTHREAD_COAPS=y
CONFIG_MBEDTLS_KEY_EXCHANGE_PSK_ENABLED=y
CONFIG_MBEDTLS_TLS_VERSION_1_2=y
CONFIG_MBEDTLS_DTLS=y
CONFIG_MBEDTLS_SSL_EXPORT_KEYS=y
CONFIG_MBEDTLS_ECP_C=y
CONFIG_MBEDTLS_ECP_NIST_OPTIM=y
CONFIG_MBEDTLS_ECJPAKE_C=y
CONFIG_MBEDTLS_KEY_EXCHANGE_ECJPAKE_ENABLED=y
CONFIG_MBEDTLS_ECP_DP_SECP256R1_ENABLED=y
CONFIG_MBEDTLS_HEAP_SIZE=16384
CONFIG_OPENTHREAD_THREAD_STACK_SIZE=6144

# Kernel options
CONFIG_MAIN_STACK_SIZE=2560

# Enable logging
CONFIG_LOG=y
CONFIG_NET_LOG=y

# Enable Network and OpenThread shell commands over USB
CONFIG_SHELL=y
CONFIG_NET_SHELL=y
CONFIG_OPENTHREAD_SHELL=y
CONFIG_USB_DEVICE_INITIALIZE_AT_BOOT=y
```

## boards/nrf52840dongle_nrf52840.conf
```kconfig
#
# Copyright (c) 2023 Nordic Semiconductor
#
# SPDX-License-Identifier: LicenseRef-Nordic-5-Clause
#

CONFIG_SHELL_BACKEND_SERIAL_INIT_PRIORITY=51

CONFIG_USB_CDC_ACM_LOG_LEVEL_OFF=y

CONFIG_USB_DEVICE_MANUFACTURER="Nordic Semiconductor ASA"
CONFIG_USB_DEVICE_PRODUCT="Thread CoAPS LED"
CONFIG_USB_DEVICE_VID=0x1915
CONFIG_USB_DEVICE_PID=0x0000
```

## src/main.c
```c
/*
 * Copyright (c) 2024 Koen Vervloesem
 *
 * SPDX-License-Identifier: Apache-2.0
 */

#include <openthread/coap_secure.h>
#include <openthread/thread.h>
#include <zephyr/drivers/gpio.h>
#include <zephyr/logging/log.h>
#include <zephyr/net/openthread.h>

LOG_MODULE_REGISTER(ot_coaps_led, LOG_LEVEL_DBG);

#define LED0_NODE DT_ALIAS(led0)
#if !DT_NODE_HAS_STATUS(LED0_NODE, okay)
#error "Unsupported board: led0 devicetree alias is not defined"
#endif
static const struct gpio_dt_spec led = GPIO_DT_SPEC_GET(LED0_NODE, gpios);

int led_state = 0;

static void led_requested(void *p_context, otMessage *p_message,
                          const otMessageInfo *p_message_info);
static void led_send_response(otMessage *p_request_message,
                              const otMessageInfo *p_message_info);

static otCoapResource led_resource = {.mUriPath = "led",
                                      .mHandler = led_requested,
                                      .mContext = NULL,
                                      .mNext = NULL};

const uint8_t *psk = "1234";
const uint8_t *psk_id = "my-id";

static void led_requested(void *p_context, otMessage *p_message,
                          const otMessageInfo *p_message_info) {
  otCoapCode method_code = otCoapMessageGetCode(p_message);
  otCoapType message_type = otCoapMessageGetType(p_message);
  char buf[1];
  int ret;

  if (message_type == OT_COAP_TYPE_CONFIRMABLE ||
      message_type == OT_COAP_TYPE_NON_CONFIRMABLE) {
    if (method_code == OT_COAP_CODE_PUT) {
      otMessageRead(p_message, otMessageGetOffset(p_message), buf, 1);
      LOG_INF("Received: %c", buf[0]);
      if (buf[0] == '0') {
        ret = gpio_pin_set_dt(&led, 0);
        led_state = 0;
      } else if (buf[0] == '1') {
        ret = gpio_pin_set_dt(&led, 1);
        led_state = 1;
      } else if (buf[0] == '2') {
        ret = gpio_pin_toggle_dt(&led);
        led_state = 1 - led_state;
      } else {
        LOG_ERR("Received unsupported payload: %c", buf[0]);
      }

      if (message_type == OT_COAP_TYPE_CONFIRMABLE) {
        led_send_response(p_message, p_message_info);
      }
    } else if (method_code == OT_COAP_CODE_GET) {
      led_send_response(p_message, p_message_info);
    }
  }
}

static void led_send_response(otMessage *p_request_message,
                              const otMessageInfo *p_message_info) {
  otError error;
  otMessage *p_response;
  otCoapCode response_code;
  otCoapType message_type;
  otInstance *p_instance = openthread_get_default_instance();
  char buf[1];

  p_response = otCoapNewMessage(p_instance, NULL);
  if (p_response == NULL) {
    LOG_ERR("Failed to create message for CoAP Response");
    return;
  }

  if (otCoapMessageGetType(p_request_message) == OT_COAP_TYPE_CONFIRMABLE) {
    message_type = OT_COAP_TYPE_ACKNOWLEDGMENT;
  } else if (otCoapMessageGetType(p_request_message) ==
             OT_COAP_TYPE_NON_CONFIRMABLE) {
    message_type = OT_COAP_TYPE_NON_CONFIRMABLE;
  } else {
    LOG_ERR("Unsupported message type in CoAP Request message: %d",
            otCoapMessageGetType(p_request_message));
    otMessageFree(p_response);
    return;
  }

  if (otCoapMessageGetCode(p_request_message) == OT_COAP_CODE_GET) {
    response_code = OT_COAP_CODE_CONTENT;
  } else if (otCoapMessageGetCode(p_request_message) == OT_COAP_CODE_PUT) {
    response_code = OT_COAP_CODE_CHANGED;
  } else {
    char *method_code_string = otCoapMessageCodeToString(p_request_message);
    LOG_ERR("Unsupported method code in CoAP Request message: %s",
            method_code_string);
    otMessageFree(p_response);
    return;
  }

  error = otCoapMessageInitResponse(p_response, p_request_message, message_type,
                                    response_code);
  if (error != OT_ERROR_NONE) {
    LOG_ERR("Failed to initialize message for CoAP Response: %s",
            otThreadErrorToString(error));
    otMessageFree(p_response);
    return;
  }

  error = otCoapMessageSetPayloadMarker(p_response);
  if (error != OT_ERROR_NONE) {
    LOG_ERR("Failed to set payload marker for CoAP Response: %s",
            otThreadErrorToString(error));
    otMessageFree(p_response);
    return;
  }

  buf[0] = led_state + 0x30;
  LOG_INF("LED state: %c", buf[0]);
  error = otMessageAppend(p_response, buf, 1);
  if (error != OT_ERROR_NONE) {
    LOG_ERR("Failed to append to CoAP Response message: %s",
            otThreadErrorToString(error));
    otMessageFree(p_response);
    return;
  }

  error = otCoapSecureSendResponse(p_instance, p_response, p_message_info);
  if (error != OT_ERROR_NONE) {
    LOG_ERR("Failed to send CoAP Response: %s", otThreadErrorToString(error));
    otMessageFree(p_response);
  }
}

void init_coap(void) {
  otError error;
  otInstance *p_instance = openthread_get_default_instance();

  otCoapSecureSetPsk(p_instance, psk, strlen(psk), psk_id, strlen(psk_id));
  LOG_INF("PSK: %s", psk);
  LOG_INF("PSK id: %s", psk_id);

  error = otCoapSecureStart(p_instance, OT_DEFAULT_COAP_SECURE_PORT);
  if (error != OT_ERROR_NONE) {
    LOG_ERR("Cannot initialize CoAPS: %s", otThreadErrorToString(error));
    return;
  }
  LOG_INF("CoAP Secure service started");
  otCoapSecureAddResource(p_instance, &led_resource);
  LOG_INF("CoAP Secure led resource started");
}

int init_led(void) {
  int ret;

  if (!gpio_is_ready_dt(&led)) {
    return 0;
  }

  ret = gpio_pin_configure_dt(&led, GPIO_OUTPUT_ACTIVE);
  if (ret < 0) {
    return 0;
  }

  return 0;
}

int main(void) {
  int ret;

  init_led();
  init_coap();
  ret = gpio_pin_set_dt(&led, 0);

  return 0;
}
```
